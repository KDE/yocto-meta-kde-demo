## conf/distro/kde-linux.conf
```bitbake
require conf/distro/poky.conf

DISTRO = "kde-linux"
DISTRO_NAME = "KDE Embedded Linux"

# this kills the python config from opkg, no idea how to kill opkg entirely yet
# PACKAGECONFIG:pn-opkg-utils = ""

# VIRTUAL-RUNTIME_dev_manager = ""
# VIRTUAL-RUNTIME_login_manager = "busybox"
VIRTUAL-RUNTIME_init_manager = "systemd"
VIRTUAL-RUNTIME_initscripts = ""
# VIRTUAL-RUNTIME_keymaps = ""
# VIRTUAL-RUNTIME_update-alternatives = ""

PREFERRED_PROVIDER_udev ?= "systemd"
PREFERRED_PROVIDER_udev-utils ?= "systemd"

# RPI default is just armv6
DEFAULTTUNE_raspberrypi = "arm1176jzfshf"

# += gstreamer webengine
DISTRO_FEATURES += " \
    systemd \
    usrmerge \
    wayland \
    pam \
    polkit \
    kde \
    vulkan \
"

# ld-is-gold fails on qemux86 with duplicated weak symbols
DISTRO_FEATURES:remove = " \
    directfb \
    irda \
    nfs \
    pcmcia \
    sysvinit \
"
```

## conf/layer.conf
```bitbake
# We have a conf and classes directory, add to BBPATH
BBPATH .= ":${LAYERDIR}"

# We have recipes-* directories, add to BBFILES
BBFILES += " \
    ${LAYERDIR}/recipes-*/*.bb \
    ${LAYERDIR}/recipes-*/*/*.bb \
    ${LAYERDIR}/recipes-*/*.bbappend \
    ${LAYERDIR}/recipes-*/*/*.bbappend \
"
BBFILES_DYNAMIC += " \
    raspberrypi:${LAYERDIR}/dynamic-layers/raspberrypi/*/*/*.bb \
    raspberrypi:${LAYERDIR}/dynamic-layers/raspberrypi/*/*/*.bbappend \
    qt5-layer:${LAYERDIR}/dynamic-layers/qt5/*/*/*.bb \
    qt5-layer:${LAYERDIR}/dynamic-layers/qt5/*/*/*.bbappend \
    qt6-layer:${LAYERDIR}/dynamic-layers/qt6/*/*/*.bb \
    qt6-layer:${LAYERDIR}/dynamic-layers/qt6/*/*/*.bbappend \
"

BBFILE_COLLECTIONS += "kde-experimental"
BBFILE_PATTERN_kde-experimental = "^${LAYERDIR}/"
BBFILE_PRIORITY_kde-experimental = "100"
LAYERSERIES_COMPAT_kde-experimental = "dunfell kirkstone langdale mickledore"
LAYERDEPENDS_kde-experimental = "core"
```
